// File generated 7/5/2016 11:32:00 PM
// Warning! This is a generated file, any manual changes will be
// lost during the next generation.

// object indexes into ImageControl
#CONST
    iAngularmeter0  // offset 0x0
    iStatictext0    // offset 0x680200
    iStatictext1    // offset 0x680800
    iLeddigits0     // offset 0x680E00
    iiLeddigits0    // offset 0x683000
    iLeddigits1     // offset 0x688400
    iiLeddigits1    // offset 0x68A600
    iLeddigits2     // offset 0x68FA00
    iiLeddigits2    // offset 0x691C00
    iStatictext2    // offset 0x697000
    iStatictext3    // offset 0x697600
    iStatictext4    // offset 0x698400
    iStatictext5    // offset 0x699000
#END

#IFNOT EXISTS NOGLOBALS
var hndl ;
#ENDIF
